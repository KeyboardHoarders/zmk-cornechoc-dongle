/*
 * Copyright (c) 2021 The ZMK Contributors
 *
 * SPDX-License-Identifier: MIT
 */

#include "cygnus.dtsi"

&default_transform {
    col-offset = <5>;
};

&kscan0 {
    col-gpios
        = <&gpio1 11 GPIO_ACTIVE_HIGH> // col3 in the schematic
        , <&gpio1 13 GPIO_ACTIVE_HIGH> // col4 in the schematic
        , <&gpio1 15 GPIO_ACTIVE_HIGH> // col5 in the schematic
        , <&gpio0 2 GPIO_ACTIVE_HIGH> // col6 in the schematic
        , <&gpio0 29 GPIO_ACTIVE_HIGH> // col6 in the schematic
        ;
};



